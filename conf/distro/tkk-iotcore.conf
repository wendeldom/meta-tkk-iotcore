## conf/distro/tkk-iotcore.conf
```bitbake
#@NAME: tkk-iotcore
#@DESCRIPTION: OpenSTLinux fuer Headless-Systeme (Keine GPU, kein Display)

require include/st-default-distro-rules.inc
require include/st-default-distro-providers.inc
require include/openstlinux.inc

DISTRO = "tkk-iotcore"
DISTRO_NAME = "TKK iot core distro"


DISTRO_FEATURES:remove = "\ 
x11 wayland pam kde splashscreen gstreamer pipewire pulseaudio alsa bluetooth bluez5 \
wifi nfs pci polkit gobject-introspection-data usbgadget usbhost\
"

DISTRO_FEATURES:append = " gplv3 "
```
